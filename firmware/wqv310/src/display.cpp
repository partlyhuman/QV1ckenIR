#ifdef ENABLE_DISPLAY_128x64
#include "display.h"

#include <Adafruit_SSD1306.h>

#include <string>

#include "Nokia_Cellphone_FC_8.h"
#include "_1980v23P04_16.h"
#include "config.h"
#include "log.h"

#define SCREEN_WIDTH 128
#define SCREEN_HEIGHT 64
#define OLED_RESET -1
#define SCREEN_ADDRESS 0x3C
#define DIM_AFTER_MS 15000

namespace Display {

static const char* TAG = "Display";

static int screen = -1;
static int model = 10;
static bool scroll = false;
static std::string modelString;
static std::string statusString;

void setModel(int m) {
    model = m;
    if (m == 3) {
        modelString = "WQV-3";
    } else if (m == 10) {
        modelString = "WQV-10";
    }
}

static Adafruit_SSD1306 display(SCREEN_WIDTH, SCREEN_HEIGHT, &Wire, OLED_RESET, I2C_CLOCK, I2C_CLOCK);

static const unsigned char image_frame0_bits[]{0xff, 0xfc, 0x80, 0x04, 0x80, 0x04, 0x80, 0x04, 0x80, 0x04,
                                               0x80, 0x04, 0x80, 0x04, 0x80, 0x04, 0x80, 0x04, 0x80, 0x04,
                                               0x80, 0x04, 0x80, 0x04, 0x80, 0x04, 0xff, 0xfc};

static const unsigned char image_frame1_bits[]{0xff, 0xfc, 0x80, 0x04, 0x80, 0x04, 0x80, 0x04, 0x80, 0x04,
                                               0x80, 0x04, 0x80, 0x04, 0x80, 0x04, 0x80, 0x04, 0x80, 0x04,
                                               0xf0, 0x04, 0x50, 0x04, 0x30, 0x04, 0x1f, 0xfc};

static const unsigned char image_frame2_bits[]{0xff, 0xfc, 0x80, 0x04, 0x80, 0x04, 0x80, 0x04, 0x80, 0x04,
                                               0x80, 0x04, 0x80, 0x04, 0xfe, 0x04, 0x42, 0x04, 0x22, 0x04,
                                               0x12, 0x04, 0x0a, 0x04, 0x06, 0x04, 0x03, 0xfc};

static const unsigned char image_frame3_bits[]{0xff, 0xfc, 0x80, 0x04, 0x80, 0x04, 0x80, 0x04, 0x80, 0x04,
                                               0xff, 0x84, 0x40, 0x84, 0x20, 0x84, 0x10, 0x84, 0x08, 0x84,
                                               0x04, 0x84, 0x02, 0x84, 0x01, 0x84, 0x00, 0xfc};

static const unsigned char image_frame4_bits[]{0xff, 0xfc, 0x80, 0x04, 0x80, 0x04, 0xff, 0xe4, 0x40, 0x24,
                                               0x20, 0x24, 0x10, 0x24, 0x08, 0x24, 0x04, 0x24, 0x02, 0x24,
                                               0x01, 0x24, 0x00, 0xa4, 0x00, 0x64, 0x00, 0x3c};

static const unsigned char* const frames[] PROGMEM{image_frame0_bits, image_frame1_bits, image_frame2_bits,
                                                   image_frame3_bits, image_frame4_bits};

static const unsigned char image_arrow_left_bits[]{0x20, 0x40, 0xfe, 0x40, 0x20};

static const unsigned char image_arrow_right_bits[]{0x08, 0x04, 0xfe, 0x04, 0x08};

static const unsigned char image_file_save_bits[]{0x7f, 0xfc, 0x90, 0xaa, 0x90, 0xa9, 0x90, 0xe9, 0x90, 0x09, 0x8f,
                                                  0xf1, 0x80, 0x01, 0x80, 0x01, 0x80, 0x01, 0x9f, 0xf9, 0x90, 0x09,
                                                  0x97, 0xe9, 0x90, 0x09, 0xd7, 0xeb, 0x90, 0x09, 0x7f, 0xfe};

bool init() {
    LOGV(TAG, "Using these pins for I2C: SDA=%d SCL=%d", PIN_I2C_SDA, PIN_I2C_SCL);
    if (!Wire.setPins(PIN_I2C_SDA, PIN_I2C_SCL) || !Wire.begin()) {
        LOGE(TAG, "Can't use these pins for I2C: SDA=%d SCL=%d", PIN_I2C_SDA, PIN_I2C_SCL);
        return false;
    }
    // SSD1306_SWITCHCAPVCC = generate display voltage from 3.3V internally
    if (!display.begin(SSD1306_SWITCHCAPVCC, SCREEN_ADDRESS)) {
        LOGE(TAG, "SSD1306 allocation failed");
        return false;
    }

#ifdef SCREEN_ROTATION
    display.setRotation(SCREEN_ROTATION);
#endif
    display.clearDisplay();
    display.display();
    dim(false);
    screen = -1;

    LOGV(TAG, "Display init");

    return true;
}

void dim(bool d) {
    if (d) {
        display.ssd1306_command(SSD1306_SETCONTRAST);
        display.ssd1306_command(0x01);
    } else {
        display.ssd1306_command(SSD1306_SETCONTRAST);
        display.ssd1306_command(0xA0);
    }
}

void stopScroll() {
    display.ssd1306_command(SSD1306_DEACTIVATE_SCROLL);
}

void startScroll() {
    // NOTE only call after display()

    // Scrolls the bottom 2 "pages" of 8px
    // Corresponding with the yellow area of the bicolour OLED screens
    // Would be nice to find a way to mount the board rightside up and restore the status bar to the top
    // But at this point that would make firmware updates a bit more difficult for users who already have a rotated
    // screen
    display.ssd1306_command(SSD1306_RIGHT_HORIZONTAL_SCROLL);
    display.ssd1306_command(0x00);
    display.ssd1306_command(0);     // start page
    display.ssd1306_command(0x00);  // interval
    display.ssd1306_command(1);     // end page
    display.ssd1306_command(0x00);
    display.ssd1306_command(0xFF);
    display.ssd1306_command(SSD1306_ACTIVATE_SCROLL);
}

void drawBar() {
    // bottom_bar
    display.fillRect(0, 55, 128, 9, 1);

    display.setTextColor(0);
    display.setTextWrap(false);
    display.setFont(&_1980v23P04_16);

    // watch_id
    if (!scroll) {
        display.setCursor(model == 3 ? 90 : 87, 62);
        display.print(modelString.c_str());
    }

    // stage
    display.setCursor(1, 62);
    display.print(statusString.c_str());
}

void showBootScreen() {
    screen = -1;
    scroll = false;
    stopScroll();

    static const unsigned char PROGMEM image__1_bits[] = {0x7c, 0xee, 0xee, 0xee, 0xee, 0xee, 0x7c};

    static const unsigned char PROGMEM image__10_bits[] = {0x7f, 0x00, 0xa0, 0x80, 0xae, 0x80, 0xae,
                                                           0x80, 0xae, 0x80, 0xa0, 0x80, 0x7f, 0x00};

    static const unsigned char PROGMEM image__2_bits[] = {0x7c, 0x82, 0xfa, 0x82, 0xbe, 0x82, 0x7c};

    static const unsigned char PROGMEM image__3_bits[] = {0x7c, 0x82, 0xfa, 0x82, 0xfa, 0x82, 0x7c};

    static const unsigned char PROGMEM image_logo_bits[] = {
        0x07, 0xff, 0xfe, 0x00, 0x7e, 0x00, 0x7f, 0xff, 0xe0, 0x07, 0xe0, 0x07, 0xff, 0xfc, 0x00, 0x3f, 0xff, 0xff,
        0x80, 0x7e, 0x03, 0xff, 0xff, 0xf8, 0x07, 0xe0, 0x3f, 0xff, 0xff, 0x80, 0x7f, 0xff, 0xff, 0xc0, 0x7e, 0x07,
        0xff, 0xff, 0xfc, 0x07, 0xe0, 0x7f, 0xff, 0xff, 0xc0, 0x7f, 0xff, 0xff, 0xe0, 0x7e, 0x07, 0xff, 0xff, 0xfe,
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        0xff, 0xfc, 0x00};

    // logo
    display.drawBitmap(6, 12, image_logo_bits, 116, 23, 1);

    // wqv-blink
    display.setTextColor(1);
    display.setTextWrap(false);
    display.setFont(&_1980v23P04_16);
    display.setCursor(34, 45);
    display.print("WQV-BLINK");

    // // 2
    // display.drawBitmap(10, 56, image__2_bits, 7, 7, 1);

    // // 1
    // display.drawBitmap(1, 56, image__1_bits, 7, 7, 1);

    // 3
    display.drawBitmap(109, 56, image__3_bits, 7, 7, 1);

    // 10
    display.drawBitmap(118, 56, image__10_bits, 9, 7, 1);

    display.display();
}

void showIdleScreen() {
    static uint32_t firstIdleScreenTime;

    if (screen == 0) {
        if (millis() - firstIdleScreenTime > DIM_AFTER_MS) {
            dim(true);
        }
        return;
    }
    dim(false);
    firstIdleScreenTime = millis();

    screen = 0;
    scroll = true;
    statusString = "SEARCHING";

    stopScroll();
    display.clearDisplay();

    // [BEGIN lopaka generated]
    static const unsigned char PROGMEM image___1_bits[] = {0x80, 0xc0, 0xe0, 0xc0, 0x80};

    static const unsigned char PROGMEM image_IR_Icon_bits[] = {
        0xff, 0xff, 0xff, 0x80, 0x00, 0x01, 0x8e, 0x00, 0x71, 0x91, 0x00, 0x89, 0xa0, 0x81, 0x05, 0xa0, 0x81,
        0x05, 0xa0, 0x81, 0x05, 0x91, 0x00, 0x89, 0x8e, 0x00, 0x71, 0x80, 0x00, 0x01, 0xff, 0xff, 0xff};

    // IR Icon
    display.drawBitmap(71, 35, image_IR_Icon_bits, 24, 11, 1);

    // Text3
    display.setTextColor(1);
    display.setTextWrap(false);
    display.setFont(&Nokia_Cellphone_FC_8);
    display.setCursor(32, 43);
    display.print("Aim at");

    // >
    display.drawBitmap(77, 23, image___1_bits, 3, 5, 1);

    // Text2
    display.setCursor(10, 28);
    display.print("COM/IR MENU   PC icon");

    // Text1
    display.setCursor(19, 15);
    display.print("WQV-3 or WQV-10:");

    display.display();

    drawBar();
    display.display();
    if (scroll) startScroll();
}

void showConnectingScreen(int offset) {
    screen = 1;
    scroll = false;
    statusString = "CONNECTING";

    stopScroll();
    display.clearDisplay();

    display.drawBitmap(48 + offset, 34, image_arrow_right_bits, 7, 5, 1);

    display.drawBitmap(69 - offset, 34, image_arrow_left_bits, 7, 5, 1);

    drawBar();
    display.display();
    if (scroll) startScroll();
}

void showProgressScreen(size_t chunkNumber, size_t totalChunks, size_t imageNumber) {
    screen = 2;
    scroll = false;
    statusString = "DOWNLOADING";
    static uint8_t frame = 0;

    stopScroll();
    display.clearDisplay();

    // bar_border
    display.drawRect(1, 38, 125, 9, 1);

    // bar_fill
    display.fillRect(3, 40, chunkNumber * 121 / totalChunks, 5, 1);

    // percent
    display.setTextColor(1);
    display.setCursor(1, 35);
    display.printf("%0.0f%%", 100.0f * chunkNumber / totalChunks);

    // photo_count
    display.setFont(&Nokia_Cellphone_FC_8);
    display.setCursor(46, 14);
    display.printf("Photo %d", imageNumber + 1);

    // frame0
    display.drawBitmap(23, 4, frames[(frame++) % 5], 14, 14, 1);

    drawBar();
    display.display();
    if (scroll) startScroll();
}

void showMountedScreen() {
    if (screen == 3) return;
    screen = 3;
    scroll = true;
    statusString = "MOUNTED";

    stopScroll();
    display.clearDisplay();

    // file_save
    display.drawBitmap(56, 3, image_file_save_bits, 16, 16, 1);

    // Layer 5
    display.setTextColor(1);
    display.setTextWrap(false);
    display.setFont(&Nokia_Cellphone_FC_8);
    display.setCursor(18, 31);
    display.print("USB drive mounted");

    // Layer 5 copy
    display.setCursor(22, 42);
    display.print("Eject when done!");

    drawBar();
    display.display();
    if (scroll) startScroll();
}

// Currently unused
size_t printf(const char* format, ...) {
    va_list args;
    va_start(args, format);
    size_t result = display.printf(format, args);
    va_end(args);
    return result;
}

}  // namespace Display

#endif